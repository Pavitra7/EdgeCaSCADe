## os/zephyr/zephyrdebug/boards/riscv/comet/Kconfig.board
```kconfig
# SPDX-License-Identifier: Apache-2.0

config BOARD_COMET
	bool "COMET target"
	depends on SOC_COMET
	select CONSOLE_HAS_DRIVER
```

## os/zephyr/zephyrdebug/boards/riscv/comet/Kconfig.defconfig
```kconfig
# SPDX-License-Identifier: Apache-2.0

if BOARD_COMET

config BOARD
	default "comet"
	
config MP_NUM_CPUS
    int
    default 1
    
endif
```

## os/zephyr/zephyrdebug/boards/riscv/comet/comet_defconfig
```kconfig
# SPDX-License-Identifier: Apache-2.0

CONFIG_SOC_COMET=y
CONFIG_BOARD_COMET=y
CONFIG_RISCV_GENERIC_TOOLCHAIN=y
CONFIG_KERNEL_ENTRY="_start"
# CONFIG_SYS_CLOCK_TICKS_PER_SEC=1000
CONFIG_SYS_CLOCK_HW_CYCLES_PER_SEC=200000000

CONFIG_SERIAL=y
CONFIG_CONSOLE=y
CONFIG_TICKLESS_KERNEL=y
CONFIG_RAM_CONSOLE=n
CONFIG_UART_LITEUART=y
CONFIG_UART_CONSOLE=y

CONFIG_SMP=n
CONFIG_MP_NUM_CPUS=1
CONFIG_RISCV_PMP=n
CONFIG_USERSPACE=n

CONFIG_LED=n
CONFIG_I2C=n
CONFIG_RISCV_HAS_PLIC=n
CONFIG_RISCV_HAS_CPU_IDLE=n
CONFIG_XIP=n
CONFIG_FPU=n
```

## os/zephyr/zephyrdebug/soc/riscv/comet/Kconfig.defconfig
```kconfig
# Copyright (c) 2018 - 2019 Antmicro <www.antmicro.com>
# SPDX-License-Identifier: Apache-2.0

if SOC_COMET

config SOC
	default "comet"
	
config FPU
	default n

config SYS_CLOCK_HW_CYCLES_PER_SEC
	default 100000000

config RISCV_SOC_INTERRUPT_INIT
	default n

config RISCV_HAS_CPU_IDLE
	default n

config RISCV_HAS_PLIC
	default n
	  	
config NUM_IRQS
	default 12
        
config ATOMIC_OPERATIONS_C
        default n
        
config XIP
	default n
	
endif # SOC_COMET
```

## os/zephyr/zephyrdebug/soc/riscv/comet/Kconfig.soc
```kconfig
# Copyright (c) 2018 - 2019 Antmicro <www.antmicro.com>
# SPDX-License-Identifier: Apache-2.0

config SOC_COMET
    bool "Comet SOC"
	select RISCV
	select RISCV_MACHINE_TIMER
	select ATOMIC_OPERATIONS_C if !SMP
	select ATOMIC_OPERATIONS_BUILTIN if SMP
```
